## conf/layer.conf
```bitbake
# We have a conf and classes directory, append to BBPATH
BBPATH .= ":${LAYERDIR}"

BBFILES += "${LAYERDIR}/recipes*/*/*.bb ${LAYERDIR}/recipes*/*/*.bbappend ${LAYERDIR}/images/*.bb"

BBFILE_COLLECTIONS += "meta-jumpnow"
BBFILE_PATTERN_meta-jumpnow := "^${LAYERDIR}/"
BBFILE_PRIORITY_meta-jumpnow = "12"

LAYERSERIES_COMPAT_meta-jumpnow = "dunfell"
```
